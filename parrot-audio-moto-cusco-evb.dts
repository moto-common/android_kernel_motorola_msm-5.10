/dts-v1/;
/plugin/;

#include "parrot-cuso-audio-overlay.dtsi"
/{
	model = "cusco";
	compatible = "qcom,parrot-qrd", "qcom,parrot", "qcom,qrd", "moto,cusco";
	qcom,msm-id = <537 0x10000>;
	qcom,board-id = <0x45 0x9000>;
};

