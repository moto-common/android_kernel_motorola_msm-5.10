## drivers/input/misc/ets_bix_mmi/Kconfig
```kconfig
config EGIS_PANEL_NOTIFICATIONS
	bool "EGIS Panel Notifications"
	depends on INPUT_EGIS_BIX_MMI
	default n
	help
	  Say Y here to enable EGIS panel notifications.
	  If unsure, say N.

# Uncomment the following block if you have a specific configuration for ET721_FOD
#config ET721_FOD
#	bool "ET721 FOD"
#	depends on TOUCHSCREEN_EGIS_BIX_MMI
#	default n
#	help
#	  Say Y here to enable ET721 FOD.
#	  If unsure, say N.

config INPUT_EGIS_BIX_MMI
	tristate "EGIS BIX fingerprint MMI"
	default n
	help
	  Say Y here to build the EGIS BIX fingerprint MMI driver as a module.
	  If unsure, say N.
```

## drivers/misc/mmi_sys_temp/Kconfig
```kconfig
config MMI_SYS_TEMP
    tristate "MMI System Temperature"
    default n
    help
      Say Y here to build the MMI System Temperature driver as a module.
      If unsure, say N.
```

## drivers/power/Kconfig
```kconfig
# SPDX-License-Identifier: GPL-2.0-only
source "drivers/power/reset/Kconfig"
source "drivers/power/supply/Kconfig"
source "drivers/power/bq27426_fg_mmi/Kconfig"
source "drivers/power/mmi_charger/Kconfig"
source "drivers/power/qpnp_adaptive_charge/Kconfig"
```

## drivers/power/bq27426_fg_mmi/Kconfig
```kconfig
config ATL_4000MAH_8A_BATTERY_PROFILE
	bool "ATL 4000mAh 8A Battery Profile"
	depends on BQ27426_FG_MMI
	default n
	help
	  Say Y here to enable support for the ATL 4000mAh 8A battery profile.
	  If unsure, say N.

config SCUD_4000MAH_8A_BATTERY_PROFILE
	bool "SCUD 4000mAh 8A Battery Profile"
	depends on BQ27426_FG_MMI
	default n
	help
	  Say Y here to enable support for the SCUD 4000mAh 8A battery profile.
	  If unsure, say N.

config ATL_LS40_1545MAH_BATTERY_PROFILE
	bool "ATL LS40 1545mAh Battery Profile"
	depends on BQ27426_FG_MMI
	default n
	help
	  Say Y here to enable support for the ATL LS40 1545mAh battery profile.
	  If unsure, say N.

config ATL_LS30_1255MAH_BATTERY_PROFILE
	bool "ATL LS30 1255mAh Battery Profile"
	depends on BQ27426_FG_MMI
	default n
	help
	  Say Y here to enable support for the ATL LS30 1255mAh battery profile.
	  If unsure, say N.

config ATL_NM40_712MAH_BATTERY_PROFILE
	bool "ATL NM40 712mAh Battery Profile"
	depends on BQ27426_FG_MMI
	default n
	help
	  Say Y here to enable support for the ATL NM40 712mAh battery profile.
	  If unsure, say N.

config BQ27426_FG_MMI
	tristate "BQ27426 Fuel Gauge MMI"
	default n
	help
	  Say Y here to build the BQ27426 Fuel Gauge MMI driver as a module.
	  If unsure, say N.
```

## drivers/power/mmi_charger/Kconfig
```kconfig
config MMI_RECHARGER_HAWAO_MODE
	bool "MMI Recharger Hawao Mode"
	depends on MMI_CHARGER
	default n
	help
	  Say Y here to enable MMI Recharger Hawao Mode.
	  If unsure, say N.

config MMI_CHARGER
	tristate "MMI Charger"
	depends on POWER_SUPPLY
	default n
	help
	  Say Y here to build the MMI Charger driver as a module.
	  If unsure, say N.
```

## drivers/power/qpnp_adaptive_charge/Kconfig
```kconfig
config USE_MMI_CHARGER
	bool "Use MMI Charger"
	depends on QPNP_ADAPTIVE_CHARGE
	default n
	help
	  Say Y here to enable the use of MMI Charger.
	  If unsure, say N.

config ADAPTIVE_TOLERANCE_OPTIMIZATION
	bool "Adaptive Tolerance Optimization"
	depends on QPNP_ADAPTIVE_CHARGE
	default n
	help
	  Say Y here to enable adaptive tolerance optimization.
	  If unsure, say N.

config QPNP_ADAPTIVE_CHARGE
	tristate "QPNP Adaptive Charge"
	depends on INPUT
	default n
	help
	  Say Y here to build the QPNP Adaptive Charge driver as a module.
	  If unsure, say N.
```

## drivers/power/qti_glink_charger/Kconfig
```kconfig
config WIRELESS_CPS4035B
	depends on QTI_GLINK_CHARGER
	bool "Wireless Charger CPS4035B"
	default n
	help
	  Say Y here to enable support for Wireless Charger CPS4035B.
	  If unsure, say N.

config WIRELESS_CPS4019
	depends on QTI_GLINK_CHARGER
	bool "Wireless Charger CPS4019"
	default n
	help
	  Say Y here to enable support for Wireless Charger CPS4019.
	  If unsure, say N.

config SKIP_QTI_CHARGER_CONFIRMAION
	depends on QTI_GLINK_CHARGER
	bool "Skip QTI Charger Confirmation"
	default n
	help
	  Say Y here to skip QTI charger confirmation.
	  If unsure, say N.

config QTI_GLINK_CHARGER
	tristate "QTI GLINK Charger"
	default n
	help
	  Say Y here to build the QTI GLINK Charger driver as a module.
	  If unsure, say N.
```
